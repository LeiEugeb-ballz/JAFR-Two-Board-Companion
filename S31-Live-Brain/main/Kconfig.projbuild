## S31-Live-Brain/main/Kconfig.projbuild
```kconfig
menu "ESP32-S31 Voice Terminal Configuration"

    config ESP_WIFI_SSID
        string "WiFi SSID"
        default "2.4GHz"
        help
            SSID of the 2.4GHz Wi-Fi network.

    config ESP_WIFI_PASSWORD
        string "WiFi Password"
        default ""
        help
            Password of the Wi-Fi network. Keep the generated sdkconfig local;
            never commit credentials.

    config ESP_STATIC_IP
        string "ESP32 Static IPv4 Address"
        default "192.168.88.242"
        help
            Static IPv4 address assigned to the ESP32-S31 terminal.

    config ESP_NETMASK
        string "ESP32 Subnet Netmask"
        default "255.255.255.0"
        help
            Subnet netmask for the network topology.

    config ESP_GATEWAY_IP
        string "Router/AP Gateway IPv4 Address"
        default "192.168.88.1"
        help
            IPv4 address of the Wi-Fi AP router / default gateway.

    config PC_GATEWAY_IP
        string "PC Voice Gateway IPv4 Address"
        default "192.168.88.252"
        help
            IPv4 address of the PC running the Voice Gateway service.

    config PC_GATEWAY_UDP_PORT
        int "PC Voice Gateway UDP Port"
        default 5000
        help
            UDP port to send outgoing microphone PCM audio frames.

    config ESP_LISTEN_UDP_PORT
        int "ESP32 Listening UDP Port"
        default 5001
        help
            UDP port to receive return PCM audio frames from PC.

endmenu
```

## S31-Live-Brain/sdkconfig.defaults
```kconfig
# Target configuration
CONFIG_IDF_TARGET="esp32s31"

# Compiler optimization
CONFIG_COMPILER_OPTIMIZATION_DEFAULT=y
CONFIG_ESPTOOLPY_FLASHSIZE_16MB=y
CONFIG_PARTITION_TABLE_CUSTOM=y
CONFIG_PARTITION_TABLE_CUSTOM_FILENAME="partitions_jafr.csv"
CONFIG_ETH_USE_ESP32_EMAC=y
CONFIG_ETH_EMAC_RGMII_TX_CLK_SRC_APLL=y

# Log output
CONFIG_LOG_DEFAULT_LEVEL_INFO=y
CONFIG_LOG_MAXIMUM_LEVEL_VERBOSE=y

# M2 custom BLE GATT audio central: scan/connect to the DualEye receiver only.
CONFIG_BT_ENABLED=y
CONFIG_BT_NIMBLE_ENABLED=y
CONFIG_BT_CONTROLLER_ENABLED=y
CONFIG_BT_NIMBLE_ROLE_CENTRAL=y
# CONFIG_BT_NIMBLE_ROLE_PERIPHERAL is not set
# CONFIG_BT_NIMBLE_ROLE_BROADCASTER is not set
CONFIG_BT_NIMBLE_ROLE_OBSERVER=y
CONFIG_BT_NIMBLE_GATT_CLIENT=y
# CONFIG_BT_NIMBLE_GATT_SERVER is not set
CONFIG_BT_NIMBLE_MAX_CONNECTIONS=1
CONFIG_BT_NIMBLE_ATT_PREFERRED_MTU=247
```
